## tls/main/Kconfig.projbuild
```kconfig
menu "Wifi configuration"

    config ESP_WIFI_SSID
        string "WiFi SSID"
        default "myssid"
        help
            SSID (network name) to connect to.

    config ESP_WIFI_PASSWORD
        string "WiFi Password"
        default "mypassword"
        help
            WiFi password (WPA or WPA2) to use.

    config ESP_MAXIMUM_RETRY
        int "Maximum retry"
        default 5
        help
            Set the Maximum retry to avoid station reconnecting to the AP
            unlimited when the AP is really inexistent.

    config ESP_TCPIP_ADAPTER
        bool "Use TCPIP Adapter (For esp8266)"
        default n
        help
            Use TCPIP Adapter for network interface initialization.
    
    config ESP_NETIF
        bool "Use ESP Netif (For esp32)"
        default y
        help
            Use ESP Netif for network interface initialization.

endmenu

menu "MQTT Broker configuration"

    config BROKER_URL
        string "Broker URL"
        default "mqtt://mqtt.eclipseprojects.io"
        help
            MQTT URL of the broker to connect to

    config MQTT_USER
        string "Client Username"
        default "esp32"
        help
            MQTT Client username. set either "esp32-x" or "esp8266-x". Replacing "x" with 1, 2, or 3.

    config MQTT_PASS
        string "Client Password"
        default "world"
        help
            MQTT Client password

    config MQTT_REQ
        string "Request topic"
        default "request1"
        help
            MQTT topic for the client to subscribe to

    config MQTT_RES
        string "Request topic"
        default "response1"
        help
            MQTT topic for the client to publish the payload to

endmenu
```
